/* Copyright (c) 2021-2022 The ZMK Contributors
 * SPDX-License-Identifier: MIT
 * Removed spi and stuff due to errors and not using
 */

#include <dt-bindings/led/led.h>

/* SPI and LED underglow disabled: no display/LEDs present on this build */
&spi1 {
	status = "disabled";
};